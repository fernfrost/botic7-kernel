## sound/soc/generic/Kconfig
```kconfig
config SND_SIMPLE_CARD_UTILS
       tristate

config SND_SIMPLE_CARD
	tristate "ASoC Simple sound card support"
	select SND_SIMPLE_CARD_UTILS
	help
	  This option enables generic simple sound card support

config SND_BOTIC_CARD
	tristate "ASoC Botic sound card support"
	help
	  This option enables Botic sound card support

config SND_AM33XX_SOC_BOTIC
	tristate "Botic on BeagleBone Black"
	depends on SOC_AM33XX
	select SND_BOTIC_CARD
	select SND_EDMA_SOC
	select SND_DAVINCI_SOC_MCASP
	help
	  Say Y or M if you want to add support for Botic on BeagleBone Black.
```
